## fs/exfat/Kconfig
```kconfig
config FS_EXFAT
    bool "Enable exFAT"
    default y
    depends on FS_VFS
    help
      Answer Y to enable LiteOS-A exFAT filesystem support (read-side v1; mount,
      lookup, readdir, read paths). Requires LOSCFG_FS_VFS. Generated from
      Linux fs/exfat/ via the specfs-port plugin (see spec/exfat/).
```

## kernel/extended/hilog/Kconfig
```kconfig
config HILOG
    tristate "Hilog support"
    default y
    help
      hilog buffer manager.

      Hilog is a simple log manager for OpenHarmonyOS.
      log string write to /dev/hilog, and the hilog driver copy it
      to the ring buffer. Ring buffer can be read from userspace.

config HILOG_BUFFER_SIZE
    int "hilog buffer size"
    default 262144
    help
      Define the default ring buffer size of hilog. 256 KiB chosen to retain
      enough boot/panic context for kernel debugging on QEMU dev trees while
      remaining tractable on memory-constrained targets (Hi3516 has ~32 MiB
      RAM, this default uses < 1%). Embedded products may override downward
      via their product kconfig if memory pressure demands.
```
